//-------------------------------------------------------------------------
//      ILINK command file template for the Renesas RH850 microcontroller
//
//      Copyright 2012 IAR Systems AB.
// 
//      $Revision: 6737 $
//-------------------------------------------------------------------------

define memory mem with size = 4G;

define region ROM_near   = mem:[from 0x00000100 to 0x00007FFF];
define region ROM_region = mem:[from 0x00000100 to 0x0003FFFF];

define region RAM_near   = mem:[from 0xFEE00000 to 0xFEE07FFF];
define region RAM_region = mem:[from 0xFEE00000 to 0xFEE07FFF];

define region ROM_data   = mem:[from 0xFF200000 to 0xFF207FFF];

include "layout.icf";

//-------------------------------------------------------------------------
//      End of File
//-------------------------------------------------------------------------


