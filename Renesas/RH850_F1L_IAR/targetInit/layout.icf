//-------------------------------------------------------------------------
//      ILINK layout template for the Renesas RH850 microcontroller
//
//      Copyright 2012 IAR Systems AB.
// 
//      $Revision: 6799 $
//-------------------------------------------------------------------------

initialize by copy { rw };
do not initialize  { section .*.noinit };

initialize by copy with packing = none { section __DLIB_PERTHREAD };

// define GP relative sections here
define block SBSS with static base GP, alignment=8, maximum size = 64K
                                { section __DLIB_PERTHREAD,
                                  rw section .sbss*,
                                  rw section .sdata* };
define block SBSS23 with alignment=8, maximum size = 8M 
                                { rw section .sdata23*,
                                  midway block SBSS,
                                  rw section .sbss23* };

define block TP_BLOCK with static base TP, alignment=8, maximum size = 64K { ro section .sconst };
define block TP23_BLOCK with alignment=8, maximum size = 8m { ro section .sconst23,
                                                              midway block TP_BLOCK };

define block ROM_BLOCK with fixed order { 
                                          block TP23_BLOCK
                                        };

define block EP_BLOCK with alignment=8, maximum size=16 { rw section .tbss4*,
                                                          rw section .tdata4* };
define block EBSS5      with fixed order, maximum size = 32
                                { block EP_BLOCK, 
                                  rw section .tbss5*,
                                  rw section .tdata5* };

define block EBSS6      with fixed order, maximum size = 64
                                { block EBSS5,
                                  rw section .tbss6*,
                                  rw section .tdata6* };

define block EBSS7      with fixed order, maximum size = 128
                                { block EBSS6, 
                                  rw section .tbss7*,
                                  rw section .tdata7* };

define block EBSS8 with static base EP, fixed order, maximum size = 256
                                { block EBSS7,
                                  rw section .tbss8*,
                                  rw section .tdata8* };

define block CALLT      with fixed order, maximum size = 64k, alignment = 2
                                { ro section .table.callt,
                                  ro section .text.callt };

define block TRAP       with fixed order, maximum size = 64k, alignment = 2
                                { ro section .dispatch.trap,
                                  ro section .table.trap,
                                  ro section .text.trap };

define block FETRAP     with fixed order, maximum size = 64k, alignment = 2
                                { ro section .dispatch.fetrap,
                                  ro section .table.fetrap,
                                  ro section .text.fetrap };

define block HVTRAP     with fixed order, maximum size = 64k, alignment = 2
                                { ro section .dispatch.hvtrap,
                                  ro section .table.hvtrap,
                                  ro section .text.hvtrap };

define block RAM_BLOCK with fixed order { block SBSS23,
                                          block EBSS8,
                                       };
 
define block HEAP     with alignment = 8, size = HEAP_SIZE {  };
define block CSTACK   with alignment = 8, size = CSTACK_SIZE {  };
define block .reset with alignment = 16 
                      { ro section RCODE, 
                        ro section .reset,
                      };

define block .syscalltable with alignment = 4 
                      {  
                        ro section .syscalltable
                      };

define block .hvcalltable with alignment = 4 
                      {  
                        ro section .hvcalltable
                      };

"RESET":place at address mem:0x0 { block .reset };

"NEARROM":place in ROM_near    { ro section .const,
                                 ro section .zconst
                               };
                                                                                   
"NEARRAM":place in RAM_near    { rw section .bss,  
                                 rw section .zbss,
                                 rw section .data,
                                 rw section .zdata
                               };
                                                                                   
"ROM":place in ROM_region      { block CALLT,
                                 block TRAP,
                                 block FETRAP,
                                 block HVTRAP,
                                 ro,                
                                 block .syscalltable,
                                 block .hvcalltable,
                                 block ROM_BLOCK
                               };
"RAM":place in RAM_region      { rw,               
                                 block RAM_BLOCK,
                                 block HEAP,
                                 block CSTACK 
                               };
                               
//-------------------------------------------------------------------------
//      End of File
//-------------------------------------------------------------------------